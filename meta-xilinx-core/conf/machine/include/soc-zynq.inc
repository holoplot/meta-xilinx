## meta-xilinx-core/conf/machine/include/soc-zynq.inc
```bitbake
DEFAULTTUNE ?= "cortexa9thf-neon"
SOC_FAMILY ?= "zynq"

require conf/machine/include/soc-family.inc
require soc-tune-include.inc

# Linux Configuration
ARCH_DEFAULT_KERNELIMAGETYPE:zynq = "uImage"

UBOOT_ELF ?= "u-boot.elf"
```

## meta-xilinx-core/conf/machine/microblaze-v-generic.conf
```bitbake
#@TYPE: Machine
#@NAME: microblaze-v-generic
#@DESCRIPTION: Machine configuration for the microblaze-v-generic devices

#### Preamble
MACHINEOVERRIDES =. "${@['', 'microblaze-v-generic:']['microblaze-v-generic' != '${MACHINE}']}"
#### Regular settings follow

# Set the default for a modern full feature (32-bit) microblaze-v...
# Note, glibc does not support 'f' without 'd'
TUNE_FEATURES:tune-microblaze-v ?= "${@mbv.tune.riscv_isa_to_tune("rv32imac_zicbom_zicsr_zifencei_zba_zbb_zbs")}"

# Variables that changes based on hw design or board specific requirement must be
# defined before calling the required inclusion file else pre-expansion value
# defined in local.conf without machine override will not be reflected.
PREFERRED_PROVIDER_virtual/bootloader ?= "u-boot-xlnx"
PREFERRED_PROVIDER_virtual/kernel ?= "linux-yocto"

PREFERRED_VERSION_openocd-native = "riscv"
PREFERRED_VERSION_openocd = "riscv"

XVISOR_PLAT:riscv32 = "riscv/virt32"
XVISOR_PLAT:riscv64 = "riscv/virt64"

UBOOT_BOOT_SCRIPT ??= ""
UBOOT_MACHINE:riscv32 = "qemu-riscv32_smode_defconfig"
UBOOT_MACHINE:riscv64 = "qemu-riscv64_smode_defconfig"

require conf/machine/include/soc-microblaze-v.inc
require conf/machine/include/machine-xilinx-default.inc
require conf/machine/include/machine-xilinx-qemu.inc

# qemu-xilinx, in riscv64 mode may just exist when USB is initialized
PREFERRED_PROVIDER_qemu-native = "qemu-native"
PREFERRED_PROVIDER_qemu-system-native = "qemu-system-native"

MACHINE_FEATURES += "keyboard ext2 ext3 serial"

SERIAL_CONSOLES ?= "115200;ttyS0 115200;hvc0"

IMAGE_FSTYPES += "ext4 wic.qcow2"

IMAGE_CLASSES += "image-types-xilinx-qemu"
# Add wic.qemu-sd only if initramfs_image not set due to circular dependecies
IMAGE_FSTYPES += "${@'wic.qemu-sd' if (d.getVar('INITRAMFS_IMAGE') or '') == '' else 'cpio.gz'}"

WKS_FILE ?= "qemuriscv.wks"

MACHINE_EXTRA_RRECOMMENDS += " kernel-modules"

EXTRA_IMAGEDEPENDS += "opensbi"
RISCV_SBI_PLAT ?= "generic"
RISCV_SBI_PAYLOAD ?= "${KERNEL_IMAGETYPE}-${MACHINE}.bin"

UBOOT_ENTRYPOINT:riscv32 = "0x80400000"
UBOOT_ENTRYPOINT:riscv64 = "0x80200000"

# The default MACHINE_ARCH is dynamic for microblaze-v, since the architecture is not fixed
MACHINE_ARCH_ORIG := "${MACHINE_ARCH}"
MACHINE_ARCH_DYN := "microblaze_${TUNE_RISCV_PKGARCH}_generic"

MACHINE_ARCH = "${@['${MACHINE_ARCH_DYN}', '${MACHINE_ARCH_ORIG}']['microblaze-v-generic' != "${MACHINE}"]}"

# qemuboot options
QB_SMP ?= "-smp 4"
QB_KERNEL_CMDLINE_APPEND = "earlycon=sbi"
QB_MACHINE = "-machine virt"
QB_DEFAULT_BIOS = "fw_jump.elf"
QB_TAP_OPT = "-netdev tap,id=net0,ifname=@TAP@,script=no,downscript=no"
QB_NETWORK_DEVICE = "-device virtio-net-device,netdev=net0,mac=@MAC@"
QB_ROOTFS_OPT = "-drive id=disk0,file=@ROOTFS@,if=none,format=raw -device virtio-blk-device,drive=disk0"
QB_SERIAL_OPT = "-device virtio-serial-device -chardev null,id=virtcon -device virtconsole,chardev=virtcon"
QB_TCPSERIAL_OPT = " -device virtio-serial-device -chardev socket,id=virtcon,port=@PORT@,host=127.0.0.1,nodelay=on -device virtconsole,chardev=virtcon"
QB_GRAPHICS = "-device bochs-display"
QB_OPT_APPEND = "-device qemu-xhci -device usb-tablet -device usb-kbd"
QB_OPT_APPEND:riscv32 = "-device virtio-tablet-pci -device virtio-keyboard-pci"

#### No additional settings should be after the Postamble
#### Postamble
PACKAGE_EXTRA_ARCHS:append = "${@['', ' microblaze_v_generic']['microblaze-v-generic' != "${MACHINE}"]}"
```

## meta-xilinx-core/conf/machine/versal-2ve-2vm-common.conf
```bitbake
#@TYPE: Machine
#@NAME: versal-2ve-2vm-common
#@DESCRIPTION: Machine configuration for a common Versal Gen 2 filesystem devices

#### Preamble
MACHINEOVERRIDES =. "${@['', 'versal-2ve-2vm-common:']['versal-2ve-2vm-common' != '${MACHINE}']}"
#### Regular settings follow

DEFAULTTUNE = "cortexa72-cortexa53"

require conf/machine/versal-2ve-2vm-generic.conf

MACHINE_FEATURES += "\
    vcu2 \
    malig78ae \
    fpga-overlay \
    optee \
    "

#### No additional settings should be after the Postamble
#### Postamble
PACKAGE_EXTRA_ARCHS:append = "${@['', ' versal_2ve_2vm_common']['versal-2ve-2vm-common' != "${MACHINE}"]}"
```

## meta-xilinx-core/conf/machine/versal2-common.conf
```bitbake
#@TYPE: Machine
#@NAME: versal2-common
#@DESCRIPTION: Machine configuration for a common Versal2 filesystem devices

#### Preamble
MACHINEOVERRIDES =. "${@['', 'versal2-common:']['versal2-common' != '${MACHINE}']}"
#### Regular settings follow

DEFAULTTUNE = "cortexa72-cortexa53"

require conf/machine/versal2-generic.conf

MACHINE_FEATURES += "\
    vcu2 \
    malig78ae \
    fpga-overlay \
    optee \
    "

#### No additional settings should be after the Postamble
#### Postamble
PACKAGE_EXTRA_ARCHS:append = "${@['', ' versal2_common']['versal2-common' != "${MACHINE}"]}"
```

## meta-xilinx-imgrcvry/conf/distro/xilinx-image-recovery.conf
```bitbake
require conf/distro/amd-edf-small.conf

DISTRO = "xilinx-image-recovery"
DISTRO_NAME = "Image Recovery Distribution Configuration"

DISTRO_VERSION = "1.1"

DISTROOVERRIDES .= ":imgrcvry"

SDK_VENDOR = "-imgrcvrysdk"

MAINTAINER = "AMD AECG <meta-xilinx@yoctoproject.org>"

TARGET_VENDOR = "-imgrcvry"

PREFERRED_PROVIDER_virtual/bootloader = "u-boot-xlnx-imgrcvry"

MACHINE_FEATURES:remove = "optee"
```
